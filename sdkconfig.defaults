## sdkconfig.defaults
```kconfig
# ESP32-S3 MQTT TLS Example Configuration

# WiFi Configuration
CONFIG_EXAMPLE_WIFI_SSID="YOUR_WIFI_SSID"
CONFIG_EXAMPLE_WIFI_PASSWORD="YOUR_WIFI_PASSWORD"

# MQTT Configuration
CONFIG_BROKER_URL="mqtts://test.mosquitto.org:8883"

# ESP32-S3 Configuration
CONFIG_IDF_TARGET_ESP32S3=y
CONFIG_IDF_TARGET="esp32s3"

# Enable WiFi
CONFIG_ESP32_WIFI_ENABLED=y
CONFIG_ESP_WIFI_SOFTAP_SUPPORT=y

# MBEDTLS Configuration
CONFIG_MBEDTLS_CERTIFICATE_BUNDLE=y
CONFIG_MBEDTLS_DEFAULT_CERTIFICATE_BUNDLE=y

# Increase main task stack size for MQTT
CONFIG_ESP_MAIN_TASK_STACK_SIZE=8192

# Enable MQTT over SSL
CONFIG_ESP_TLS_USING_MBEDTLS=y
CONFIG_ESP_TLS_SERVER_CERT_SELECT_HOOK=y

# Partition table
CONFIG_PARTITION_TABLE_SINGLE_APP=y

# Serial flasher config for ESP32-S3
CONFIG_ESPTOOLPY_FLASHMODE_QIO=y
CONFIG_ESPTOOLPY_FLASHFREQ_80M=y
CONFIG_ESPTOOLPY_FLASHSIZE_4MB=y

# Enable PSRAM for ESP32-S3
# CONFIG_ESP32S3_SPIRAM_SUPPORT=y
# CONFIG_SPIRAM_MODE_OCT=y
# CONFIG_SPIRAM=y
# CONFIG_SPIRAM_BOOT_INIT=y
# CONFIG_SPIRAM_USE_CAPS_ALLOC=y
```
